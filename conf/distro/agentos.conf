## conf/distro/agentos.conf
```bitbake
# agentos.conf

require conf/distro/poky.conf

DISTRO = "agentos"
DISTRO_NAME = "AgentOS"
DISTRO_VERSION = "1"

DISTRO_FEATURES = "acl ipv4 ipv6 usbgadget usbhost xattr pci nfc vfat seccomp multiarch ldconfig"
DISTRO_FEATURES += " systemd"
DISTRO_FEATURES += " rauc"

# support building Xen, KVM, Libvirt, and associated
# packages necessary for constructing OE-based virtualized solutions.
DISTRO_FEATURES += "virtualization"

#DISTRO_EXTRA_RDEPENDS=""
#DISTRO_EXTRA_RRECOMMENDS=""

#TCLIBC=""

INIT_MANAGER = "systemd"
VIRTUAL-RUNTIME_init_manager = "systemd"

#SPLASH = "plymouth"
#PREFERRED_PROVIDER_virtual/psplash = "plymouth"

#SPLASH = "psplash"
#PREFERRED_PROVIDER_virtual/psplash = "psplash"

# Vanilla psplash is able to use vc4 DRM fb
#SPLASH = "psplash-drm"
#PREFERRED_PROVIDER_virtual/psplash = "psplash-drm"
```

## conf/layer.conf
```bitbake
# meta-agentos/conf/layer.conf

BBPATH .= ":${LAYERDIR}"

BBFILES += "${LAYERDIR}/recipes-*/*/*.bb \
            ${LAYERDIR}/recipes-*/*/*.bbappend \
            ${LAYERDIR}/images/*.bb"

BBFILE_COLLECTIONS += "meta-agentos"
BBFILE_PATTERN_meta-agentos := "^${LAYERDIR}/"
BBFILE_PRIORITY_meta-agentos = "10"

#LAYERDEPENDS_meta-agentos = "core meta-oe meta-python meta-networking meta-raspberrypi"
LAYERDEPENDS_meta-agentos = "core openembedded-layer networking-layer meta-python raspberrypi"

LAYERSERIES_COMPAT_meta-agentos = "whinlatter walnascar scarthgap styhead"
```

## wic/core-image-agentos.wks
```
bootloader --ptable gpt
part /boot --source bootimg-partition --ondisk mmcblk0 --fstype=vfat --label boot_A --active --align 4096 --size 100
part /boot --source bootimg-partition --ondisk mmbclk0 --fstype=vfat --label boot_B --align 4096 --size 100
part / --source rootfs --ondisk mmcblk0 --fstype=ext4 --label rootfs_A --align 4096
part / --source rootfs --ondisk mmcblk0 --fstype=ext4 --label rootfs_B --align 4096
part /data --ondisk mmcblk0 --fstype=ext4 --label data --align 4096 --size 100M --fsoptions "x-systemd.growfs"
```

## wic/rpi-boot-only.wks
```
# short-description: Create Raspberry Pi SD card image with ONLY boot files and vfat partition

part /boot --source bootimg-partition --ondisk mmcblk0 --fstype=vfat --label boot --active --align 4096 --size 100
```
